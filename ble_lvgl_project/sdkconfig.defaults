## ble_lvgl_project/sdkconfig.defaults
```kconfig
CONFIG_BT_ENABLED=y
CONFIG_BT_BLUEDROID_ENABLED=y
CONFIG_BT_GATTC_ENABLE=y
CONFIG_BT_GATT_ENABLE=y
CONFIG_FREERTOS_HZ=1
CONFIG_ESP_SYSTEM_EVENT_TASK_STACK_SIZE=4096
CONFIG_ESP_MAIN_TASK_STACK_SIZE=4096
CONFIG_BT_BLE_DYNAMIC_ENV_MEMORY=y
CONFIG_ESPBT_TASK_STACK_SIZE=4096
```
